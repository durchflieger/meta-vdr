## conf/layer.conf
```bitbake
# We have a conf and classes directory, append to BBPATH
BBPATH .= ":${LAYERDIR}"

# We have a recipes directory, add to BBFILES
BBFILES += "${LAYERDIR}/recipes-*/*.bb ${LAYERDIR}/recipes-*/*.bbappend \
            ${LAYERDIR}/recipes-*/*/*.bb ${LAYERDIR}/recipes-*/*/*.bbappend"

BBFILE_COLLECTIONS += "vdr-layer"
BBFILE_PATTERN_vdr-layer := "^${LAYERDIR}/"
BBFILE_PRIORITY_vdr-layer = "100"

LAYERSERIES_COMPAT_vdr-layer = "honister"
```
